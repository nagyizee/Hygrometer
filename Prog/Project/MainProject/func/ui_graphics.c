#include <stdlib.h>
#include <string.h>

#ifdef USE_GLIB_ON_EWARM
    #include "stm32f10x.h"
    #include "stdlib_extension.h"
#endif

#include "typedefs.h"
#include "ui_graphics.h"
#include "graphic_lib.h"

////////////////////////////////////////////////////
//
//   Fonst
//
////////////////////////////////////////////////////


// Static Buffer in data space for font 'font_large_num'
const uint8 font_large_num[]= { 0xC0, 0x16, 0x00, 0x20, 0x03, 0xFF, 0xFF, 0xFF, 0xFF, 0x2F, 0x09, 0xF8, 0x7F, 0x00, 0x00, 0x00,
                              0x00, 0x00, 0x00, 0x00, 0x00, 0x00, 0x00, 0x00, 0x00, 0x00, 0x00, 0x00, 0x00, 0x00, 0x00, 0x00,
                              0x00, 0x00, 0x00, 0x00, 0x08, 0xF7, 0xF7, 0xE7, 0xE7, 0xE7, 0xEF, 0xEF, 0x00, 0x00, 0x00, 0x00,
                              0x00, 0x00, 0x00, 0x00, 0x00, 0x00, 0x00, 0x00, 0x00, 0x00, 0x00, 0x00, 0x00, 0x00, 0x00, 0x00,
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                              0x00, 0x00, 0x00, 0x00};



// Static Buffer in data space for font 'font_small'
const uint8 font_small[]  = { 0x46, 0x08, 0x00, 0x01, 0x5F, 0x00, 0x00, 0x00, 0x00, 0x04, 0x5A, 0x00, 0x00, 0x00, 0x00, 0x04,
                              0x60, 0x6F, 0x6F, 0x00, 0x00, 0x04, 0xE4, 0x61, 0x78, 0x04, 0x00, 0x04, 0x9B, 0x44, 0x92, 0x0D,
                              0x00, 0x05, 0xC4, 0x99, 0x51, 0x93, 0x05, 0x02, 0x06, 0x00, 0x00, 0x00, 0x00, 0x02, 0x56, 0x25,
                              0x00, 0x00, 0x00, 0x02, 0xA9, 0x1A, 0x00, 0x00, 0x00, 0x03, 0xAA, 0x00, 0x00, 0x00, 0x00, 0x05,
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                              0x00, 0x05, 0x00, 0xC8, 0x9A, 0x00, 0x00};


// Static Buffer in data space for font 'font_small_bold'
const uint8 font_small_bold[] = { 0x49, 0x08, 0x00, 0x02, 0xFF, 0x33, 0x00, 0x00, 0x00, 0x00, 0x00, 0x00, 0x03, 0x3D, 0x00, 0x00,
                              0x00, 0x00, 0x00, 0x00, 0x00, 0x05, 0xEA, 0x7F, 0xF5, 0xBF, 0x02, 0x00, 0x00, 0x00, 0x05, 0xCA,
                              0xAF, 0xE7, 0xF5, 0x53, 0x00, 0x00, 0x00, 0x06, 0xD3, 0x86, 0x30, 0x84, 0x2D, 0x03, 0x00, 0x00,
                              0x06, 0xCE, 0xE6, 0xBC, 0xFB, 0xEE, 0x02, 0x00, 0x00, 0x01, 0x03, 0x00, 0x00, 0x00, 0x00, 0x00,
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                              0xB7, 0x6D, 0xFB, 0x00, 0x00, 0x00, 0x00, 0x00, 0x05, 0xC0, 0x36, 0x00, 0x00, 0x00, 0x00, 0x00,
                              0x00};


// Static Buffer in data space for font 'font_micro'
const uint8 font_micro[] =  { 0x44, 0x06, 0x00, 0x01, 0x17, 0x00, 0x00, 0x03, 0x2F, 0x00, 0x00, 0x03, 0x7D, 0x5F, 0x00, 0x03,
                              0x5A, 0x2D, 0x00, 0x03, 0xA5, 0x52, 0x00, 0x03, 0xAA, 0x6A, 0x00, 0x01, 0x03, 0x00, 0x00, 0x02,
                              0x56, 0x02, 0x00, 0x02, 0xA9, 0x01, 0x00, 0x03, 0xAA, 0x00, 0x00, 0x03, 0xD0, 0x05, 0x00, 0x02,
                              0x00, 0x0E, 0x00, 0x03, 0xC0, 0x01, 0x00, 0x01, 0x10, 0x00, 0x00, 0x03, 0x94, 0x94, 0x00, 0x03,
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                              0x33, 0x00, 0x00};


////////////////////////////////////////////////////
//
//   Bitmaps
//
////////////////////////////////////////////////////


// Graphic data for main_selector.pbm 
// bitmap size: 68 x 47
const uint8 uibm_start_screen[] = { 
            0x00, 0x00, 0xf8, 0x0f, 0x00, 0x00, 0x00, 0x00, 0xff, 0x7f, 0x00, 0x00, 0x00, 0xc0, 0xff, 0xff,
            0x01, 0x00, 0x00, 0xe0, 0xff, 0xff, 0x03, 0x00, 0x00, 0xf0, 0xff, 0xff, 0x07, 0x00, 0x00, 0x18,
            0x00, 0x00, 0x0e, 0x00, 0x00, 0xdc, 0xfe, 0xff, 0x1f, 0x00, 0x00, 0xde, 0x66, 0x66, 0x3e, 0x00,
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            0x00, 0x00, 0x00, 0x00, 0xf8, 0x0f, 0x00, 0x00 };
// data size = 408

// Graphic data for icon_cb_selected.pbm
// bitmap size: 8 x 8
const uint8 uibm_grf_selected[] = {
            0x00, 0x10, 0x60, 0x30, 0x08, 0x04, 0x02, 0x00 };
// data size = 8


// Graphic data for gauge_note_HI.pbm 
// bitmap size: 24 x 22
const uint8 uibm_grf_gauge_HI[] = { 
            0x00, 0x00, 0x00, 0x00, 0x00, 0x00, 0x01, 0x00, 0x10, 0xff, 0xff, 0x1f, 0xff, 0xff, 0x1f, 0xff,
            0xff, 0x1f, 0x01, 0x0e, 0x10, 0x00, 0x0e, 0x00, 0x00, 0x0e, 0x00, 0x01, 0x0e, 0x10, 0xff, 0xff,
            0x1f, 0xff, 0xff, 0x1f, 0xff, 0xff, 0x1f, 0x01, 0x00, 0x10, 0x00, 0x00, 0x00, 0x01, 0x00, 0x10,
            0x03, 0x00, 0x18, 0xff, 0xff, 0x1f, 0xff, 0xff, 0x1f, 0xff, 0xff, 0x1f, 0x03, 0x00, 0x18, 0x01,
            0x00, 0x10, 0x00, 0x00, 0x00, 0x00, 0x00, 0x00 };
// data size = 72

// Graphic data for gauge_note_LO.pbm 
// bitmap size: 24 x 22
const uint8 uibm_grf_gauge_LO[] = { 
            0x01, 0x00, 0x10, 0xff, 0xff, 0x1f, 0xff, 0xff, 0x1f, 0xff, 0xff, 0x1f, 0x03, 0x00, 0x18, 0x01,
            0x00, 0x18, 0x00, 0x00, 0x18, 0x00, 0x00, 0x18, 0x00, 0x00, 0x18, 0x00, 0x00, 0x1c, 0x00, 0x00,
            0x1e, 0x00, 0x00, 0x00, 0xf0, 0xff, 0x01, 0xfc, 0xff, 0x07, 0xfe, 0xff, 0x0f, 0x0f, 0x00, 0x1f,
            0x07, 0x00, 0x1c, 0x07, 0x00, 0x1c, 0x07, 0x00, 0x1c, 0x07, 0x00, 0x1c, 0x0f, 0x00, 0x1e, 0xfe,
            0xff, 0x0f, 0xfc, 0xff, 0x07, 0xf0, 0xff, 0x01 };
// data size = 72

// Graphic data for quicksw_THB_rate.pbm 
// bitmap size: 12 x 33
const uint8 uibm_grf_THP_rate[] = { 
            0x00, 0x00, 0x00, 0x00, 0x00, 0x00, 0x00, 0x00, 0x00, 0x00, 0x00, 0x00, 0x18, 0x1e, 0x00, 0x00,
            0xc0, 0x1e, 0x21, 0x00, 0xfe, 0xf3, 0x80, 0x40, 0x00, 0x00, 0x03, 0x80, 0x5e, 0x00, 0x54, 0x00,
            0x80, 0x4a, 0x00, 0x54, 0x00, 0x83, 0x44, 0x00, 0x00, 0xc0, 0x03, 0x21, 0x00, 0x00, 0x00, 0x00,
            0x1e, 0x00, 0x00, 0x00, 0x00, 0x00, 0x00, 0x00, 0x00, 0x00, 0x00, 0x00 };
// data size = 60


// Graphic data for operation_none.pbm 
// bitmap size: 13 x 13
const uint8 uibm_icon_op_none[] = { 
            0xfc, 0x07, 0xfe, 0x0f, 0xff, 0x1f, 0xe7, 0x1c, 0x47, 0x1c, 0x0f, 0x1e, 0x1f, 0x1f, 0x0f, 0x1e,
            0x47, 0x1c, 0xe7, 0x1c, 0xff, 0x1f, 0xfe, 0x0f, 0xfc, 0x07 };
// data size = 26

// Graphic data for operation_register.pbm 
// bitmap size: 13 x 13
const uint8 uibm_icon_op_reg[] = { 
            0xfc, 0x07, 0x06, 0x08, 0xbf, 0x1d, 0xdf, 0x1d, 0xef, 0x1d, 0xef, 0x1d, 0xef, 0x1d, 0xdf, 0x1d,
            0xbf, 0x1d, 0x7f, 0x1d, 0x7f, 0x1d, 0xbe, 0x0d, 0xfc, 0x07 };
// data size = 26

// Graphic data for operation_register_monitor.pbm 
// bitmap size: 13 x 13
const uint8 uibm_icon_op_reg_moni[] = { 
            0xfc, 0x07, 0x06, 0x0c, 0xbf, 0x1e, 0xdf, 0x1e, 0xed, 0x16, 0xe9, 0x12, 0xe1, 0x10, 0xd9, 0x12,
            0xbd, 0x16, 0xbf, 0x1e, 0xdf, 0x1e, 0xee, 0x0e, 0xfc, 0x07 };
// data size = 26

// Graphic data for operation_monitor.pbm 
// bitmap size: 13 x 13
const uint8 uibm_icon_op_moni[] = { 
            0xfc, 0x07, 0xfe, 0x0f, 0xff, 0x1f, 0xff, 0x1f, 0x0d, 0x16, 0xd9, 0x13, 0xb1, 0x11, 0xd9, 0x13,
            0x0d, 0x16, 0xff, 0x1f, 0xff, 0x1f, 0xfe, 0x0f, 0xfc, 0x07 };
// data size = 26


// Graphic data for regstat_started.pbm 
// bitmap size: 11 x 9
const uint8 uibm_icon_regstat_started[] = { 
            0xff, 0x01, 0xff, 0x01, 0x83, 0x01, 0x7d, 0x01, 0x01, 0x01, 0x45, 0x01, 0x6d, 0x01, 0x7d, 0x01,
            0x83, 0x01, 0xff, 0x01, 0xff, 0x01 };
// data size = 22

// Graphic data for regstat_stopped.pbm 
// bitmap size: 11 x 9
const uint8 uibm_icon_regstat_stopped[] = { 
            0xff, 0x01, 0xff, 0x01, 0x83, 0x01, 0x7d, 0x01, 0x45, 0x01, 0x45, 0x01, 0x45, 0x01, 0x7d, 0x01,
            0x83, 0x01, 0xff, 0x01, 0xff, 0x01 };
// data size = 22

// Graphic data for regstat_H.pbm 
// bitmap size: 15 x 9
const uint8 uibm_icon_regstat_H[] = { 
            0xaa, 0x00, 0xff, 0x01, 0xee, 0x00, 0xef, 0x01, 0xee, 0x00, 0xff, 0x01, 0x82, 0x00, 0xef, 0x01,
            0x82, 0x00, 0xff, 0x01, 0xee, 0x00, 0xef, 0x01, 0xee, 0x00, 0xff, 0x01, 0xaa, 0x00 };
// data size = 30

// Graphic data for regstat_HP.pbm 
// bitmap size: 15 x 9
const uint8 uibm_icon_regstat_HP[] = { 
            0xaa, 0x00, 0xff, 0x01, 0xee, 0x00, 0xef, 0x01, 0xee, 0x00, 0xff, 0x01, 0x82, 0x00, 0xef, 0x01,
            0x82, 0x00, 0xff, 0x01, 0x82, 0x00, 0xdb, 0x01, 0xe6, 0x00, 0xff, 0x01, 0xaa, 0x00 };
// data size = 30

// Graphic data for regstat_P.pbm 
// bitmap size: 15 x 9
const uint8 uibm_icon_regstat_P[] = { 
            0xaa, 0x00, 0xff, 0x01, 0xee, 0x00, 0xef, 0x01, 0xee, 0x00, 0xff, 0x01, 0xee, 0x00, 0xef, 0x01,
            0xee, 0x00, 0xff, 0x01, 0x82, 0x00, 0xdb, 0x01, 0xe6, 0x00, 0xff, 0x01, 0xaa, 0x00 };
// data size = 30

// Graphic data for regstat_T.pbm 
// bitmap size: 15 x 9
const uint8 uibm_icon_regstat_T[] = { 
            0xaa, 0x00, 0xff, 0x01, 0xfa, 0x00, 0x83, 0x01, 0xfa, 0x00, 0xff, 0x01, 0xee, 0x00, 0xef, 0x01,
            0xee, 0x00, 0xff, 0x01, 0xee, 0x00, 0xef, 0x01, 0xee, 0x00, 0xff, 0x01, 0xaa, 0x00 };
// data size = 30

// Graphic data for regstat_TH.pbm 
// bitmap size: 15 x 9
const uint8 uibm_icon_regstat_TH[] = { 
            0xaa, 0x00, 0xff, 0x01, 0xfa, 0x00, 0x83, 0x01, 0xfa, 0x00, 0xff, 0x01, 0x82, 0x00, 0xef, 0x01,
            0x82, 0x00, 0xff, 0x01, 0xee, 0x00, 0xef, 0x01, 0xee, 0x00, 0xff, 0x01, 0xaa, 0x00 };
// data size = 30

// Graphic data for regstat_THP.pbm 
// bitmap size: 15 x 9
const uint8 uibm_icon_regstat_THP[] = { 
            0xaa, 0x00, 0xff, 0x01, 0xfa, 0x00, 0x83, 0x01, 0xfa, 0x00, 0xff, 0x01, 0x82, 0x00, 0xef, 0x01,
            0x82, 0x00, 0xff, 0x01, 0x82, 0x00, 0xdb, 0x01, 0xe6, 0x00, 0xff, 0x01, 0xaa, 0x00 };
// data size = 30

// Graphic data for regstat_TP.pbm 
// bitmap size: 15 x 9
const uint8 uibm_icon_regstat_TP[] = { 
            0xaa, 0x00, 0xff, 0x01, 0xfa, 0x00, 0x83, 0x01, 0xfa, 0x00, 0xff, 0x01, 0xee, 0x00, 0xef, 0x01,
            0xee, 0x00, 0xff, 0x01, 0x82, 0x00, 0xdb, 0x01, 0xe6, 0x00, 0xff, 0x01, 0xaa, 0x00 };
// data size = 30

// Graphic data for regstat_Task1.pbm 
// bitmap size: 14 x 9
const uint8 uibm_icon_regstat_task1[] = { 
            0xfe, 0x00, 0xff, 0x01, 0xf9, 0x01, 0x01, 0x01, 0x01, 0x01, 0xf9, 0x01, 0xff, 0x01, 0x33, 0x01,
            0x01, 0x01, 0x01, 0x01, 0x3f, 0x01, 0xff, 0x01, 0xff, 0x01, 0xff, 0x01 };
// data size = 28

// Graphic data for regstat_Task2.pbm 
// bitmap size: 14 x 9
const uint8 uibm_icon_regstat_task2[] = { 
            0xfe, 0x00, 0xff, 0x01, 0xff, 0x01, 0xf9, 0x01, 0x01, 0x01, 0x01, 0x01, 0xf9, 0x01, 0xff, 0x01,
            0x19, 0x01, 0x09, 0x01, 0x01, 0x01, 0x23, 0x01, 0xff, 0x01, 0xff, 0x01 };
// data size = 28

// Graphic data for regstat_Task3.pbm 
// bitmap size: 14 x 9
const uint8 uibm_icon_regstat_task3[] = { 
            0xfe, 0x00, 0xff, 0x01, 0xff, 0x01, 0xf9, 0x01, 0x01, 0x01, 0x01, 0x01, 0xf9, 0x01, 0xff, 0x01,
            0x39, 0x01, 0x29, 0x01, 0x01, 0x01, 0x93, 0x01, 0xff, 0x01, 0xff, 0x01 };
// data size = 28

// Graphic data for regstat_Task4.pbm 
// bitmap size: 14 x 9
const uint8 uibm_icon_regstat_task4[] = { 
            0xfe, 0x00, 0xff, 0x01, 0xff, 0x01, 0xf9, 0x01, 0x01, 0x01, 0x01, 0x01, 0xf9, 0x01, 0xff, 0x01,
            0x87, 0x01, 0x83, 0x01, 0x11, 0x01, 0x19, 0x01, 0xff, 0x01, 0xff, 0x01 };
// data size = 28




const uint8* bitmap_list[] = { uibm_start_screen,     uibm_grf_selected,     uibm_grf_gauge_HI,     uibm_grf_gauge_LO,
                               uibm_grf_THP_rate,     uibm_icon_op_none,     uibm_icon_op_moni,     uibm_icon_op_reg,
                               uibm_icon_op_reg_moni, uibm_icon_regstat_started, uibm_icon_regstat_stopped,  uibm_icon_regstat_H,
                               uibm_icon_regstat_HP,  uibm_icon_regstat_P,   uibm_icon_regstat_T,   uibm_icon_regstat_TH,
                               uibm_icon_regstat_THP, uibm_icon_regstat_TP,  uibm_icon_regstat_task1, uibm_icon_regstat_task2,
                               uibm_icon_regstat_task3, uibm_icon_regstat_task4 };

const uint16 bitmap_size[] = { 68,47,  8,8,   24,22,  24,22,
                               12,33,  13,13, 13,13,  13,13,
                               13,13,  11,9,  11,9,   15,9,
                               15,9,   15,9,  15,9,   15,9,
                               15,9,   15,9,  14,9,   14,9,
                               14,9,   14,9 
                         };
const uint16 bitmap_datasz[] = { 408,  8,     72,     72,
                                 60,   26,    26,     26,
                                 26,   22,    22,     30,
                                 30,   30,    30,     30,
                                 30,   30,    28,     28,
                                 28,   28
                         };



const char mounthname[] = "IAN\0FEB\0MAR\0APR\0MAY\0JUN\0JUL\0AUG\0SEP\0OCT\0NOV\0DEC\0";
const char dayname_upcase[] = "MON\0TUE\0WEN\0THU\0FRI\0SAT\0SUN\0";
const char dayname_locase[] = "Mon\0Tue\0Wen\0Thu\0Fri\0Sat\0Sun\0";

int poz_2_increment( int poz )
{
    int i;
    int val = 1;
    for (i=0; i<poz; i++)
    {
        val = val * 10;
    }
    return val;
}

static void internal_display_number( int value, int chnr, char fillchar, uint32 radix, bool force_sign, bool force_minus )
{
    char str[9];
    char str1[9];
    int i;

    if ( chnr >= 8 )
        return;

    if ( force_sign && (value>=0) )
    {
        if ( force_minus )
            str1[0]='-';
        else
            str1[0]='+';

        itoa( value, str1+1, radix );
    }
    else
        itoa( value, str1, radix );


    if ( fillchar != 0x00 )
    {
        for ( i=0; i<chnr; i++ )
            str[i]  = fillchar;
        str[i]      = 0x00;

        i = strlen( str1 );
        if ( i > chnr )
            i = chnr;
        strncpy( (str + chnr - i), str1, i );
        Gtext_PutText( str );
    }
    else
        Gtext_PutText( str1 );
}


void uibm_put_bitmap( int x, int y, int bmp )
{

    int w;
    int h;
    w = bitmap_size[ bmp*2 ];
    h = bitmap_size[ bmp*2 + 1 ];

    Bitmap_StartDrawing( x, y, w, h, false, gpixformat_1bit );
    Bitmap_DrawStream( bitmap_list[bmp], bitmap_datasz[bmp] );
    Bitmap_StopDrawing();
}


void uigrf_draw_battery( int x, int y, int fullness )
{
    int pixsize;

    Graphic_SetColor( 1 );
    Graphic_Rectangle( x+2, y, x+5, y+1 );
    Graphic_FillRectangle( x, y+2, x+7, y+13, 0 );
    // pixel space inside the indicator zone: 10
    pixsize = fullness / 10;
    if ( pixsize )
    {
        Graphic_FillRectangle( x+1, y+12-pixsize, x+6, y+12, 1 );
    }
}


void uigrf_rounded_rect( int x1, int y1, int x2, int y2, int color, bool fill, int bgnd )
{
    Graphic_SetColor( color );
    if (fill)
    {
        Graphic_FillRectangle( x1, y1, x2, y2, bgnd );

        Graphic_PutPixel(  x1, y1, bgnd );
        Graphic_PutPixel(  x1, y1+1, bgnd );
        Graphic_PutPixel(  x1+1, y1, bgnd );
        Graphic_PutPixel(  x1+1, y1+1, color);

        Graphic_PutPixel(  x2, y1, bgnd );
        Graphic_PutPixel(  x2, y1+1, bgnd );
        Graphic_PutPixel(  x2-1, y1, bgnd );
        Graphic_PutPixel(  x2-1, y1+1, color );

        Graphic_PutPixel(  x1,   y2, bgnd );
        Graphic_PutPixel(  x1,   y2-1, bgnd );
        Graphic_PutPixel(  x1+1, y2, bgnd );
        Graphic_PutPixel(  x1+1, y2-1, color );

        Graphic_PutPixel(  x2,   y2, bgnd );
        Graphic_PutPixel(  x2,   y2-1, bgnd );
        Graphic_PutPixel(  x2-1, y2, bgnd );
        Graphic_PutPixel(  x2-1, y2-1, color );
    }
    else
    {
        Graphic_Rectangle( x1+2, y1, x2-2, y1 );
        Graphic_Rectangle( x1+2, y2, x2-2, y2 );
        Graphic_Rectangle( x1, y1+2, x1, y2-2 );
        Graphic_Rectangle( x2, y1+2, x2, y2-2 );

        Graphic_PutPixel(  x1+1, y1+1, color);
        Graphic_PutPixel(  x2-1, y1+1, color );
        Graphic_PutPixel(  x1+1, y2-1, color );
        Graphic_PutPixel(  x2-1, y2-1, color );
    }

}


void grf_setup_font( enum Etextstyle style, int color, int backgnd )
{
    bool mono;

    if ( style & uitxt_MONO )
        mono = true;
    else
        mono = false;

    style = (enum Etextstyle)(style & ~uitxt_MONO );

    if ( style == uitxt_small )
        Gtext_SetFontAndColors( font_small, mono, color, backgnd );
    else if ( style == uitxt_smallbold )
        Gtext_SetFontAndColors( font_small_bold, mono, color, backgnd );
    else if ( style == uitxt_micro )
        Gtext_SetFontAndColors( font_micro, mono, color, backgnd );
    else if ( style == uitxt_large_num )
        Gtext_SetFontAndColors( font_large_num, mono, color, backgnd );
    else if ( style == uitxt_system )
        Gtext_SetFontAndColors( NULL, mono, color, backgnd );

}



void uigrf_text( int x, int y, enum Etextstyle style, char *text )
{
    grf_setup_font( style, 1, 0 );
    Gtext_SetCoordinates( x, y );
    Gtext_PutText( text );
}

void uigrf_text_inv( int x, int y, enum Etextstyle style, char *text )
{
    grf_setup_font( style, 0, 1 );
    Gtext_SetCoordinates( x, y );
    Gtext_PutText( text );
}


void uigrf_text_mono( int x, int y, enum Etextstyle style, char *text, bool specialdot )
{
    grf_setup_font( (enum Etextstyle)(style | uitxt_MONO), 1, -1 );
    Gtext_SetCoordinates( x, y );
    if (specialdot == false)
        Gtext_PutText( text );
    else
    {
        int i;
        int len;

        len = strlen(text);
        for (i=0; i<len; i++)
        {
            if ( text[i] != '.' )
                grf_setup_font( (enum Etextstyle)(style | uitxt_MONO), 1, -1 );
            else
                grf_setup_font( style, 1, -1 );
            Gtext_PutChar( text[i] );
        }
    }
}

void uigrf_putnr( int x, int y, enum Etextstyle style, int nr, int digits, char fill, bool show_plus_sign )
{
    grf_setup_font( style, 1, 0 );
    Gtext_SetCoordinates( x, y );
    internal_display_number( nr, digits, fill, 10, show_plus_sign, false );
}

void uigrf_puthex( int x, int y, enum Etextstyle style, int nr, int digits, char fill )
{
    grf_setup_font( style, 1, 0 );
    Gtext_SetCoordinates( x, y );
    Gtext_PutText( "0x" );
    internal_display_number( nr, digits, fill, 16, false, false );
}

// nr of digits - max. digits to display
// fp - how many digits are after the decimal point
void uigrf_putfixpoint( int x, int y, enum Etextstyle style, int nr, int digits, int fp, char fill, bool show_plus_sign )
{
    int len;
    int div = 1;
    grf_setup_font( style, 1, 0 );
    Gtext_SetCoordinates( x, y );
    len = digits - fp;  // length of integer part or whole part
    div = poz_2_increment( fp );    // convert the value
    internal_display_number( nr/div, len, fill, 10, show_plus_sign, (nr < 0)? true : false );
    Gtext_PutChar('.');
    nr = nr % div;
    if ( nr < 0 )
        nr = -nr;
    internal_display_number( nr, fp, '0', 10, false, false );
}


void uigrf_puttime( int x, int y, enum Etextstyle style, int color, timestruct time, bool minute_only, bool large_border )
{
    int height;
    int width;
    int w_nr;
    int w_spacer;

    grf_setup_font( (enum Etextstyle)style, color, -1 );
    height = Gtext_GetCharacterHeight();

    grf_setup_font( (enum Etextstyle)(style), color, -1 );
    w_spacer = Gtext_GetCharacterWidth(':') + 1;
    w_nr = Gtext_GetCharacterWidth('&') + 1;
    if ( minute_only )
        width = 4*w_nr+w_spacer;
    else
        width = 6*w_nr+2*w_spacer;

    // available formats:   00:00:00

    // make the background
    Graphic_SetColor( 1-color );
    if ( large_border )
        Graphic_FillRectangle( x-1, y-1, x+width+1, y+height+1, 1-color );
    else
        Graphic_FillRectangle( x, y, x+width-2, y+height-2, 1-color );
    Gtext_SetCoordinates( x, y );

    // print the time in hh:mm:ss
    grf_setup_font( (enum Etextstyle)(style | uitxt_MONO), color, -1 );
    internal_display_number( time.hour, 2, '0', 10, false, false );
    grf_setup_font( (enum Etextstyle)(style), color, -1 );
    Gtext_PutChar( ':' );
    grf_setup_font( (enum Etextstyle)(style | uitxt_MONO), color, -1 );
    internal_display_number( time.minute, 2, '0', 10, false, false );
    if ( minute_only == false )
    {
        grf_setup_font( (enum Etextstyle)(style), color, -1 );
        Gtext_PutChar( ':' );
        grf_setup_font( (enum Etextstyle)(style | uitxt_MONO), color, -1 );
        internal_display_number( time.second, 2, '0', 10, false, false );
    }

}


void uigrf_putdate( int x, int y, enum Etextstyle style, int color, datestruct mdate, bool show_year, bool show_mname )
{
    int height;
    int width;
    int w_nr;
    int w_spacer;

    grf_setup_font( (enum Etextstyle)style, color, -1 );
    height = Gtext_GetCharacterHeight();

    grf_setup_font( (enum Etextstyle)(style), color, -1 );
    w_spacer = Gtext_GetCharacterWidth('-') + 1;
    w_nr = Gtext_GetCharacterWidth('&') + 1;
    if ( show_year )
        width = (8+show_mname)*w_nr+2*w_spacer;
    else
        width = (4+show_mname)*w_nr+w_spacer;

    // available formats:   0000/nnn/dd
    //                      0000/mm/dd
    // make background
    Graphic_SetColor( 1-color );
    Graphic_FillRectangle( x, y, x+width-2, y+height-2, 1-color );
    Gtext_SetCoordinates( x, y );

    // print the date
    if ( show_year )
    {
        grf_setup_font( (enum Etextstyle)(style | uitxt_MONO), color, -1 );
        internal_display_number( mdate.year , 4, '0', 10, false, false );
        grf_setup_font( (enum Etextstyle)(style), color, -1 );
        Gtext_PutChar( '-' );
    }
    grf_setup_font( (enum Etextstyle)(style | uitxt_MONO), color, -1 );
    if ( show_mname )
        Gtext_PutText( mounthname + 4 * (mdate.mounth-1) );
    else
        internal_display_number( mdate.mounth, 2, '0', 10, false, false );
    grf_setup_font( (enum Etextstyle)(style), color, -1 );
    Gtext_PutChar( '-' );
    grf_setup_font( (enum Etextstyle)(style | uitxt_MONO), color, -1 );
    internal_display_number( mdate.day, 2, '0', 10, false, false );
}


void uigrf_putvalue_impact( int x, int y, int value, int big_digits, int small_digits, bool use_plus )
{
    // big_digits - how many big digits to be used ( if use_plus - then the first digit is a mandatory sign, if digits don't fit then '+' is ommited )
    // small_digits - how many small digits to be used (after the decimal point) - max 3
    // value - in x1000 - zecimal point is at 10^3
    int char_w;
    int char_h;
    int digits = 0;
    bool has_sign = false;
    int int_val;
    int fract_val;
    int i;

    grf_setup_font( (enum Etextstyle)(uitxt_large_num | uitxt_MONO) , 1, 0 );
    Gtext_SetCoordinates( x, y );

    int_val = value / poz_2_increment(small_digits);
    fract_val = value % poz_2_increment(small_digits);
    if ( fract_val < 0 )
        fract_val = -fract_val;

    // find out how many digits do we have in the integer part
    i = int_val;
    do
    {
        digits++;
        i /= 10;
    } while ( i );

    if ( ( digits < big_digits ) && (use_plus || (value < 0)) )
        has_sign = true;

    if ( ((value < 0) && (has_sign == false)) || (digits > big_digits) )
    {
        for (i=0; i<big_digits; i++)
            Gtext_PutChar( '#' );
        digits = -1;               // mark the failure to display
    }
    else
    {
        internal_display_number( int_val, big_digits, ' ', 10, has_sign, (value < 0) ? true : false );
    }

    // decimal point
    char_w = (Gtext_GetCharacterWidth('0') + 1) * big_digits;
    char_h = Gtext_GetCharacterHeight();
    Graphic_SetColor( 1 );
    Graphic_Rectangle( x+char_w, y+char_h-3, x+char_w+1, y+char_h-2 );

    grf_setup_font( (enum Etextstyle)(uitxt_smallbold | uitxt_MONO) , 1, 0 );
    char_h = char_h - Gtext_GetCharacterHeight();
    Gtext_SetCoordinates( x+char_w+3, y+char_h );

    if ( digits == -1 )
    {
        for (i=0; i<small_digits; i++)
            Gtext_PutChar( '#' );
    }
    else
    {
        internal_display_number( fract_val, small_digits, '0', 10, false, false );
    }
}


void uigrf_put_graph_small( int x, int y, uint8 *array, int length, int shift, int disp_up_lim, int disp_btm_lim, int digits, int decimalp )
{
    int i, j;

    Graphic_SetColor(0);
    Graphic_FillRectangle( x, y, x+50, y+40, 0 );
    Graphic_SetColor(1);

    grf_setup_font( (enum Etextstyle)(uitxt_micro | uitxt_MONO), 1, 0 );

    Gtext_SetCoordinates( x+40, y );
    if ( decimalp == 0 )
        internal_display_number( disp_up_lim, digits, ' ', 10, false, false );

    Gtext_SetCoordinates( x+40, y+36 );
    if ( decimalp == 0 )
        internal_display_number( disp_btm_lim, digits, ' ', 10, false, false );
    
    Graphic_Rectangle( x+40, y+5, x+41, y+35 );
    Graphic_Rectangle( x, y, x, y+40 );

    Graphic_SetColor( 1 );

    for (j=0; j<=5; j++)
    {
        int lim = 6;
        if ((shift % 6) == 0)
            lim = 5;
        for (i=0; i<=lim; i++)
            Graphic_PutPixel(x+i*6+(5-(shift%6)), y+j*8, 1);
    }

    for (i=0; i<(length-1); i++)
    {
        Graphic_Line( x+1+i, y+40-array[i], x+2+i, y+40-array[i+1] );
    }
}
